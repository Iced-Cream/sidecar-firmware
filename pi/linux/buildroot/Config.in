## pi/linux/buildroot/package/rytm-engine/Config.in
```kconfig
config BR2_PACKAGE_RYTM_ENGINE
	bool "rytm-engine"
	depends on BR2_TOOLCHAIN_HAS_THREADS
	select BR2_PACKAGE_LIBUSB
	help
	  Stub engine: RT audio clock and jitter test, Overbridge host on libusb.
```
